## src/examples/px4test/Kconfig
```kconfig
menuconfig EXAMPLES_PX4TEST
	bool "px4test"
	default n
	---help---
		Enable support for px4test
```

## src/modules/under_water_control/Kconfig
```kconfig
menuconfig  MODULES_UNDER_WATER_CONTROL
	bool "under water control"
	default n
	---help---
		Enable support for under_water_control
```
